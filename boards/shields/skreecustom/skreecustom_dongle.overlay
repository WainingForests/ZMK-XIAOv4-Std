#include "skreecustom.dtsi"

&default_transform {
    col-offset = <12>;
};

&kscan0 {
    row-gpios           // Row1-6 0.03 0.28 1.01 0.09 0.10 1.11 (no thumb row on dongle)
        = <&gpio0 3 (GPIO_ACTIVE_HIGH | GPIO_PULL_DOWN)>
        , <&gpio0 28 (GPIO_ACTIVE_HIGH | GPIO_PULL_DOWN)>
        , <&gpio1 1 (GPIO_ACTIVE_HIGH | GPIO_PULL_DOWN)>
        , <&gpio0 9 (GPIO_ACTIVE_HIGH | GPIO_PULL_DOWN)>
        , <&gpio0 10 (GPIO_ACTIVE_HIGH | GPIO_PULL_DOWN)>
        , <&gpio1 11 (GPIO_ACTIVE_HIGH | GPIO_PULL_DOWN)>
        ;

    col-gpios           // Col1-7 1.07 1.14 1.05 1.13 1.03 1.12 0.16
        = <&gpio1 7 GPIO_ACTIVE_HIGH>
        , <&gpio1 14 GPIO_ACTIVE_HIGH>
        , <&gpio1 5 GPIO_ACTIVE_HIGH>
        , <&gpio1 13 GPIO_ACTIVE_HIGH>
        , <&gpio1 3 GPIO_ACTIVE_HIGH>
        , <&gpio1 12 GPIO_ACTIVE_HIGH>
        , <&gpio0 16 GPIO_ACTIVE_HIGH>
        ;
};

&trackball_listener {
  status = "okay";
};

&trackball_listener2 {
  status = "okay";
};
