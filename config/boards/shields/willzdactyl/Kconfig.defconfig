## config/boards/shields/willzdactyl/Kconfig.defconfig
```kconfig
if SHIELD_WILLZDACTYL_LEFT

config ZMK_KEYBOARD_NAME
    default "Willz Dactyl"

config ZMK_SPLIT_ROLE_CENTRAL
    default y

endif

if SHIELD_WILLZDACTYL_LEFT || SHIELD_WILLZDACTYL_RIGHT

config ZMK_SPLIT
    default y

endif
```
